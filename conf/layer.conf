## conf/layer.conf
```bitbake
# We have a conf and classes directory, add to BBPATH
BBPATH .= ":${LAYERDIR}"

# We have a packages directory, add to BBFILES
BBFILES += "${LAYERDIR}/recipes-*/*/*.bb \
            ${LAYERDIR}/recipes-*/*/*.bbappend \
            ${LAYERDIR}/recipes-*/*/*/*.bbappend"

BBFILE_COLLECTIONS += "handera-arm"
BBFILE_PATTERN_handera-arm := "^${LAYERDIR}/"
BBFILE_PRIORITY_handera-arm = "4"
```

## conf/machine/amherst.conf
```bitbake
#@TYPE: Machine
#@NAME: Freescale i.MX6DL SABRE Smart Device
#@SOC: i.MX6DL
#@DESCRIPTION: Machine configuration for Freescale i.MX6DL SABRE Smart Device

# require conf/machine/include/imx6sabresd-common.inc

# SOC_FAMILY = "mx6:mx6dl"

# KERNEL_DEVICETREE = "imx6dl-sabresd.dtb"

# UBOOT_CONFIG ??= "sd"
# UBOOT_CONFIG[sd] = "mx6dlsabresd_config,sdcard"

#@TYPE: Machine
#@NAME: HandEra i.MX6 Amherst Solo
#@SOC: i.MX6S
#@DESCRIPTION: Machine configuration for i.MX6 Amherst Solo

include conf/machine/include/imx-base.inc
include conf/machine/include/tune-cortexa9.inc

SOC_FAMILY = "mx6:mx6s:amherst"

PREFERRED_PROVIDER_u-boot = "u-boot-amherst"
PREFERRED_PROVIDER_virtual/kernel = "linux-amherst"

UBOOT_MACHINE = "amherst_config"
UBOOT_SUFFIX = "bin"
UBOOT_PADDING = "2"

KERNEL_DEVICETREE = "imx6dl-amherst.dtb"

SERIAL_CONSOLE = "115200 ttymxc0"

MACHINE_FEATURES += " pci wifi bluetooth"
```

## conf/machine/amherst_quad.conf
```bitbake
#@TYPE: Machine
#@NAME: HandEra i.MX6 Amherst Quad
#@SOC: i.MX6Q
#@DESCRIPTION: Machine configuration for i.MX6 Amherst Quad

include conf/machine/include/imx-base.inc
include conf/machine/include/tune-cortexa9.inc

SOC_FAMILY = "mx6:mx6q:amherst"

PREFERRED_PROVIDER_u-boot = "u-boot-amherst"
PREFERRED_PROVIDER_virtual/kernel = "linux-amherst"

UBOOT_MACHINE = "amherst_quad_config"
UBOOT_SUFFIX = "bin"
UBOOT_PADDING = "2"

KERNEL_DEVICETREE = "imx6q-amherst.dtb"

SERIAL_CONSOLE = "115200 ttymxc0"

MACHINE_FEATURES += " pci wifi bluetooth"
```
